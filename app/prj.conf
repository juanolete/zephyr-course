## CMakeLists.txt
```
cmake_minimum_required(VERSION 3.20.0)

list(APPEND BOARD_ROOT ${CMAKE_CURRENT_SOURCE_DIR}/..)
find_package(Zephyr REQUIRED)
project(my_zephyr_app)

target_sources(app PRIVATE src/main.cpp)

add_subdirectory(drivers/my_led)
```

## Kconfig
```
menuconfig LED_SUBSYSTEM
    bool "LED Subsystem"
    default y

if LED_SUBSYSTEM

config APP_HEARTBEAT_PERIOD_MS
    int "App heartbeat period (0-1000 ms)"
    range 100 2000
    default 500

choice
    prompt "LED blink sleep time"
    default BLINK_SLEEP_500MS

config BLINK_SLEEP_250MS
    bool "250ms (super fast)"

config BLINK_SLEEP_500MS
    bool "500ms (fast)"

config BLINK_SLEEP_1000MS
    bool "1s (medium)"

config BLINK_SLEEP_2000MS
    bool "2s (slow)"

endchoice

config BLINK_SLEEP_TIME_MS 
    int # <-- No prompt = hidden
    default 250 if BLINK_SLEEP_250MS
    default 500 if BLINK_SLEEP_500MS
    default 1000 if BLINK_SLEEP_1000MS
    default 2000 if BLINK_SLEEP_2000MS
    default 0
    help
        LED Blink sleep time

menuconfig ADVANCED_LED_SETTINGS
    bool "Advanced LED settings"
    default n

if ADVANCED_LED_SETTINGS

config LED_BRIGHTNESS
    int "LED brightness (0-100)"
    range 0 100
    default 100

config LED_FADE_DURATION
    int "LED fade duration (ms)"
    range 0 5000
    default 500

menu "Expert settings"
    visible if ADVANCED_LED_SETTINGS

config ENABLE_LED_DEBUGGING
    bool "Enable LED debugging"
    default n

config CUSTOM_BLINK_PATTERN
    bool "Custom blink pattern"
    default n

endmenu

endif # ADVANCED_LED_SETTINGS

endif # LED_SUBSYSTEM


source "Kconfig.zephyr" # <-- Needed to load zephyr default configs
rsource "drivers/my_led/Kconfig"
```

## prj.conf
```kconfig
CONFIG_GPIO=y
CONFIG_LOG=y
CONFIG_MY_LED=y

# enable CLI
CONFIG_SHELL=y
# CONFIG_SHELL also enables the following CONFIGs by default
# Added here just as info
CONFIG_SHELL_CMDS=y
CONFIG_SHELL_TAB=y
CONFIG_SHELL_TAB_AUTOCOMPLETION=y
CONFIG_SHELL_HISTORY=y
CONFIG_SHELL_LOG_BACKEND=y

# more CLI commands
# CONFIG_GPIO_SHELL=y
# CONFIG_I2C_SHELL=y
# CONFIG_SENSOR_SHELL=y
# CONFIG_FLASH_SHELL=y
# CONFIG_ADC_SHELL=y
# CONFIG_FILE_SYSTEM_SHELL=y
# CONFIG_KERNEL_SHELL=y
```

## app.overlay
```dts
/ {
	aliases {
		driver-led = &green_led;
	};

	my_led: my_led {
		compatible = "my,led";
		status = "okay";
	};
};
```

## boards/nrf51dongle.overlay
```dts
/ {
	aliases {
		driver-led = &led0_red;
		driver-led-extra = &led0_blue;
	};

	my_led: my_led {
		compatible = "my,led";
		status = "okay";
	};
};
```

## boards/thingy53_nrf5340_cpuapp.overlay
```dts
/ {
	aliases {
		driver-led = &green_led;
	};

	my_led: my_led {
		compatible = "my,led";
		status = "okay";
	};
};
```

## src/main.cpp
```c
#include <zephyr/drivers/sensor.h>
#include <zephyr/drivers/gpio.h>
#include <zephyr/kernel.h>
#include <zephyr/logging/log.h>
#include <zephyr/shell/shell.h>

#include <my_led.h>

#define LED_RED     DT_ALIAS(driver_led)
#define LED_BLUE    DT_ALIAS(driver_led_extra)
#define MY_LED      DT_NODELABEL(my_led)

static const struct device* led_driver      = DEVICE_DT_GET(MY_LED);
static const struct gpio_dt_spec led_red    = GPIO_DT_SPEC_GET(LED_RED, gpios);
static const struct gpio_dt_spec led_blue   = GPIO_DT_SPEC_GET(LED_BLUE, gpios);

LOG_MODULE_REGISTER(main, LOG_LEVEL_INF);

int main(void)
{
    bool led_state = true;

    if (!gpio_is_ready_dt(&led_red)) return 0;
	LOG_INF("LED RED ready");
	
    if (gpio_pin_configure_dt(&led_red, GPIO_OUTPUT_INACTIVE) < 0) return 0;
	LOG_INF("LED RED configured");

    if (!gpio_is_ready_dt(&led_blue)) return 0;
	LOG_INF("LED BLUE ready");
	
    if (gpio_pin_configure_dt(&led_blue, GPIO_OUTPUT_INACTIVE) < 0) return 0;
	LOG_INF("LED BLUE configured");

    if (my_led_set_gpio(led_driver, &led_red) != 0) return 0;
    LOG_INF("LED RED set to LED driver");

    return 0;
}
```
